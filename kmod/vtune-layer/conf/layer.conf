## kmod/vtune-layer/conf/layer.conf
```bitbake
# We have a conf and classes directory, append to BBPATH
BBPATH .= ":${LAYERDIR}"

# add icc-runtime recipes to BBFILES
BBFILES += "${LAYERDIR}/recipes-*/*/*.bb ${LAYERDIR}/*/recipes-*/*/*.bbappend"

# Path fundamental paths to these recipies
VTUNE_LAYER_DIR = "${LAYERDIR}"

# License file
VTUNE_RECIPE_LICENSE_FILE = "file://${VTUNE_LAYER_DIR}/recipes-vtune/license.txt;md5=3a8d4c0fe388b46553f28a94913977c2"
```
